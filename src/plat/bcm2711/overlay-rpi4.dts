/*
 * Copyright 2020, Data61, CSIRO (ABN 41 687 119 230)
 * Copyright (C) 2021, Hensoldt Cyber GmbH
 *
 * SPDX-License-Identifier: GPL-2.0-only
 */

/ {
	chosen {
		seL4,elfloader-devices =
		    "serial1";

		seL4,kernel-devices =
		    "serial1",
		    &{/soc/interrupt-controller@40041000},
		    &{/soc/local_intc@40000000},
		    &{/timer};
	};

	memory@0 {
        /*
         * See BCM2711 TRM section 1.2 and
         * https://github.com/raspberrypi/firmware/issues/1374 for
         * reference.
         */

         /* RPi4B seems to be in "low peripheral" mode by default.
          * These values were observed from running
          * Raspbian instance from /proc/iomem and /sys/firmware/devicetree/base
          *
          * Set gpu_mem=64 so we have following memory ranges available
          * VC GPU RAM 64MB -> 0x40000000-0x04000000 = 0x3c000000
          *
          * 0x00 0x00000000 0x3c000000  960MB
          * 0x00 0x40000000 0xbc000000  3008MB
          * 0x01 0x00000000 0x80000000  2048MB
          * 0x01 0x80000000 0x80000000  2048MB
          */
        reg = < 0x00 0x00000000 0x3c000000 /* 960MB */
                0x00 0x40000000 0xbc000000 /* 3008MB */
                0x01 0x00000000 0x80000000 /* 2048MB */
                0x01 0x80000000 0x80000000 /* 2048MB */ >;
	};
};
